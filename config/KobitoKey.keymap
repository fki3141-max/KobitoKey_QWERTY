/*
 * KobitoKey キーマップ（まとめ役のファイル）
 *
 *   キー配置の変更   → keymap/layers/*.dtsi
 *   コンボの変更     → keymap/combos.dtsi
 *   マクロ・ホールドタップ等 → keymap/behaviors.dtsi
 *
 *   ※ レイヤーの #include の順番 = レイヤー番号。
 *     順番を変えたら keymap/kobito.h のレイヤー番号も合わせること。
 */
#include <input/processors.dtsi>
#include <behaviors.dtsi>
#include <dt-bindings/zmk/bt.h>
#include <dt-bindings/zmk/keys.h>
#include <dt-bindings/zmk/pointing.h>

#include "keymap/kobito.h"

/ {
    keymap {
        compatible = "zmk,keymap";
    };
    combos {
        compatible = "zmk,combos";
    };
};

/* ---- 独自ビヘイビア（マクロ等） ---- */
#include "keymap/behaviors.dtsi"

/* ---- レイヤー（この順番がレイヤー番号） ---- */
#include "keymap/layers/0_base.dtsi"      /* 0: BASE  */
#include "keymap/layers/1_num.dtsi"       /* 1: NUM   */
#include "keymap/layers/2_func.dtsi"      /* 2: FUNC  */
#include "keymap/layers/3_mouse.dtsi"     /* 3: MOUSE */
#include "keymap/layers/4_cursor.dtsi"    /* 4: CURSOR */

/* ---- コンボ ---- */
#include "keymap/combos.dtsi"
